## sources/meta-develer/conf/layer.conf
```bitbake
# We have a conf and classes directory, add to BBPATH
BBPATH =. "${LAYERDIR}:"

# We have recipes-* directories, add to BBFILES
BBFILES += "${LAYERDIR}/recipes-*/*/*.bb \
            ${LAYERDIR}/recipes-*/*/*.bbappend"

BBFILE_COLLECTIONS += "meta-develer"
BBFILE_PATTERN_meta-develer = "^${LAYERDIR}/"
BBFILE_PRIORITY_meta-develer = "99"

LAYERDEPENDS_meta-develer = "core"
LAYERSERIES_COMPAT_meta-develer = "honister"
```
